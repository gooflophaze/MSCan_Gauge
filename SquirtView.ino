/*
switched to https://github.com/focalintent/Adafruit_SSD1306 - showed a significant speed improvement
in the histogram function


Attempt to completely eliminate the need for the MCP2515 library by only using SPI transfers.

*/
#include <SPI.h>
#include <Wire.h>
#include <avr/pgmspace.h>

#include <Encoder.h>
Encoder myEnc(18, 19); // interrupts on pin18, 19
#define RBUTTON_INT 0 // pin 2
const unsigned long debouncing_time = 150; //Debouncing Time - 150 is good, 200 is better, 250 seems worse
volatile unsigned long last_millis; //switch debouncing 

#include <Adafruit_GFX.h>
#include <Adafruit_SSD1306.h>
#define OLED_RESET 27 //RST
Adafruit_SSD1306 display(OLED_RESET);

#include <Adafruit_NeoPixel.h>
#define NEOPIN 4

// Pin Definitions - MCP2515
#define CS_PIN 22
#define MCP_RESET_PIN 23 //this does nothing
#define INT_PIN 1 // int pin != pin output. interrupt 0 = pin3
/*
int.0 - pin.3 scl
int.1 - pin.2 sda
int.2 - pin.0 rx
int.3 - pin.1 tx
int.4 - pin.7
*/

//mcp2515.h stolen defs
#define CAN_READ        0x03
#define CAN_WRITE       0x02
#define CANINTE         0x2B
#define CANINTF         0x2C
#define BFPCTRL         0x0C
#define CANCTRL         0x0F
#define CANSTAT         0x0E

#define CNF1            0x2A
#define CNF2            0x29
#define CNF3            0x28
#define RXB0CTRL        0x60
#define RXB1CTRL        0x70

// TX Buffer 0
#define TXB0CTRL        0x30
#define TXB0SIDH        0x31
#define TXB0SIDL        0x32
#define TXB0EID8        0x33
#define TXB0EID0        0x34
#define TXB0DLC         0x35
#define TXB0D0          0x36
#define TXB0D1          0x37
#define TXB0D2          0x38
#define TXB0D3          0x39
#define TXB0D4          0x3A
#define TXB0D5          0x3B
#define TXB0D6          0x3C
#define TXB0D7          0x3D
// RX Buffer 0
#define RXB0CTRL        0x60
#define RXB0SIDH        0x61
#define RXB0SIDL        0x62
#define RXB0EID8        0x63
#define RXB0EID0        0x64
#define RXB0DLC         0x65
#define RXB0D0          0x66
#define RXB0D1          0x67
#define RXB0D2          0x68
#define RXB0D3          0x69
#define RXB0D4          0x6A
#define RXB0D5          0x6B
#define RXB0D6          0x6C
#define RXB0D7          0x6D
// RX Buffer 1
#define RXB1CTRL        0x70
#define RXB1SIDH        0x71
#define RXB1SIDL        0x72
#define RXB1EID8        0x73
#define RXB1EID0        0x74
#define RXB1DLC         0x75
#define RXB1D0          0x76
#define RXB1D1          0x77
#define RXB1D2          0x78
#define RXB1D3          0x79
#define RXB1D4          0x7A
#define RXB1D5          0x7B
#define RXB1D6          0x7C
#define RXB1D7          0x7D

static unsigned char PROGMEM miatalogo_bmp[] = {
0x00, 0x00, 0x00, 0x00, 0x00, 0x00, 0x00, 0x00, 0x00, 0x00, 0x00, 0x00, 0x00, 0x00, 0x00, 0x00,
0x00, 0x00, 0x00, 0x00, 0x00, 0x00, 0x00, 0x00, 0x00, 0x00, 0x00, 0x00, 0x00, 0x00, 0x00, 0x00,
0x00, 0x00, 0x00, 0x00, 0x00, 0x00, 0x00, 0x00, 0x00, 0x00, 0x00, 0x00, 0x00, 0x00, 0x00, 0x00,
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0x00, 0x00, 0x00, 0x00, 0x00, 0x00, 0x00, 0x00, 0x00, 0x00, 0x00, 0x00, 0x00, 0x00, 0x00, 0x00
};

struct ledval {
  byte r0;
  byte g0;
  byte b0;
  byte r1;
  byte g1;
  byte b1;
  byte r2;
  byte g2;
  byte b2;
  byte r3;
  byte g3;
  byte b3;
};

const ledval ledarray[] PROGMEM = {
//r0, g0, b0, r1, g1, b1, r2, g2, b2, r3, g3, b3
{0x0,0x5,0xFF,0x0,0x0,0x0,0x0,0x0,0x0,0x0,0x0,0x0}, //0
{0x0,0x6,0xFE,0x0,0x0,0x0,0x0,0x0,0x0,0x0,0x0,0x0}, //1
{0x0,0x7,0xFD,0x0,0x0,0x0,0x0,0x0,0x0,0x0,0x0,0x0}, //2
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{0xFF,0x5,0x0,0xFC,0x5,0x0,0xFB,0x5,0x0,0x28,0x8,0x0} //500
};
                         
struct MSDataObject {
  char name[10]; // length tbd
  byte block; // max val 32?
  unsigned int offset; // max val?
  byte reqbytes; // max val 8
  byte mult; // does this need to be * 0.1 ?
};

const MSDataObject MSData[] PROGMEM = {
// string,  block, offset, reqbytes, mult, div
  {"RPM",     7,   6,  2,    0   }, // 0
  {"AFR",     7,  252, 1,    0   }, // 1
  {"CLT",     7,  22,  2,    1   }, // 2
  {"MAP",     7,  18,  2,    1   }, // 3
  {"MAT",     7,  20,  2,    1   }, // 4
  {"SPKADV",  7,   8,  2,    1   }, // 5
  {"BATTV",   7,  26,  2,    1   }, // 6
  {"TPS",     7,  24,  2,    1   }, // 7
  {"Knock",   7,  32,  2,    1   }, // 8
  {"Baro",    7,  16,  2,    1   }, // 9
  {"EGOc",    7,  34,  2,    1   }, // 10
  {"IAC",     7,  54,  2,    0   }, // 11 -- this was GFC's to 49 / 125
  {"dwell",   7,  62,  2,    1   }, // 12
  {"bstduty", 7,  39,  1,    0   }, // 13 boost duty cycle
  {"idletar", 7, 380,  2,    0   }, // 14
  {"AFRtgt",  7,  12,  1,    1   }, // 15
};

struct MSDataBinaryObject {
  char name[14];
  byte sbyte;
  byte bitp;
};

const MSDataBinaryObject MSDataBin[] PROGMEM = {
// "1234567890"
//"name", indicator byte, bit position
//0 engine - block 7 offset 11
{"Ready",            0,  0 },
{"Crank",            0,  1 },
{"ASE",              0,  2 },
{"WUE",              0,  3 },
{"TPS acc",          0,  4 },
{"TPS dec",          0,  5 },
{"MAP acc",          0,  6 },
{"MAP dec",          0,  7 },
//1 status1 - block7 offset 78
{"Need Burn",        1,  0,},
{"Data Lost",        1,  1 },
{"Config Error",     1,  2 },
{"Synced",           1,  3 },
{"VE1/2",            1,  5 },
{"SPK1/2",           1,  6 },
{"Full-sync",        1,  7 },
//2 status2 - block 7 offset 79
{"N2O 1",            2,  0 },
{"N2O 2",            2,  1 },
{"Rev lim",          2,  2 },
{"Launch",           2,  2 },
{"Flat shift",       2,  4 },
{"Spark cut",        2,  5 },
{"Over boost",       2,  6 },
{"CL Idle",          2,  7 },
//3 status3 - block 7 offset 80 
{"Fuel cut",         3,  0 },
//{"T-log",            3,  1 },
//{"3 step",           3,  2 },
//{"Test mode",        3,  3 },
//{"3 step",           3,  4 },
{"Soft limit",       3,  5 },
//{"Bike shift",       3,  6 },
{"Launch",           3,  7 },
//4 check engine lamps - block 7 offset 425
{"cel_map",          4,  0 },
{"cel_mat",          4,  1 },
{"cel_clt",          4,  2 },
{"cel_tps",          4,  3 },
{"cel_batt",         4,  4 },
{"cel_afr0",         4,  5 },
{"cel_sync",         4,  6 },
{"cel_egt",          4,  7 },
//5 port status - block 7 offset 70
{"port0",            5,  0 },
{"port1",            5,  1 },
{"port2",            5,  2 },
{"port3",            5,  3 },
{"port4",            5,  4 },
{"port5",            5,  5 },
{"port6",            5,  6 },
//6 status6 - block 7 offset 233
{"EGT warn",         6,  0 },
{"EGT shutdown",     6,  1 },
{"AFR warn",         6,  2 },
{"AFR shutdown",     6,  3 },
{"Idle VE",          6,  4 },
{"Idle VE",          6,  5 },
{"Fan",              6,  6 },
//7 status7 - block 7 offset 351
{"Knock",            7,  4 },
{"AC",               7,  5 },
};

byte indicator[7]; // where to store indicator data

long R_index = 0; // for rotary encoder
byte B_index = 0; // Button increment
byte M_index = 0; // Menu increment
byte S_index = 0; // Select increment

byte neo_brightness = 1;
byte g_textsize = 1;
char tempchars[11];

unsigned int RPM, CLT, MAP, MAT, SPKADV, BATTV, TPS, Knock, Baro, EGOc, IAC, dwell, bstduty, idle_tar;
int AFR, AFRtgt;
unsigned int MAP_HI, Knock_HI, RPM_HI, CLT_HI, MAT_HI;
int AFR_HI, AFR_LO;

unsigned long validity_window; // for hi/low + histogram window update
unsigned long validity_window2;

byte LC1_AFR = 147;

byte histogram[64]; // 512 memory usage
byte histogram_index;

Adafruit_NeoPixel strip = Adafruit_NeoPixel(16, NEOPIN, NEO_GRB + NEO_KHZ800);

void setup() {
  Serial.begin(115200);
  pinMode(MCP_RESET_PIN, OUTPUT);
  pinMode(CS_PIN, OUTPUT);
  pinMode(OLED_RESET, OUTPUT);
  SPI.setClockDivider(SPI_CLOCK_DIV2);
  SPI.setDataMode(SPI_MODE0);
  SPI.setBitOrder(MSBFIRST);
  SPI.begin();
  digitalWrite(MCP_RESET_PIN, LOW);
  delay(10);
  digitalWrite(MCP_RESET_PIN, HIGH);
  delay(10);
  CANWrite(CANCTRL, B10000111); // conf mode
  CANWrite(CNF1, 0x00); // CNF1 b00000000
  CANWrite(CNF2, 0xA4); // CNF2 b10100100
  CANWrite(CNF3, 0x84); // CNF3 b10000100
  CANWrite(CANCTRL, B00000111); // normal mode
  delay(10);
  CANWrite(RXB0CTRL, B01101000); //RXB0CTRL clear receive buffers
  CANWrite(RXB1CTRL, B01101000); //RXB1CTRL clear receive buffers
  CANWrite(CANINTE, B00000011); // enable interrupt on RXB0, RXB1
  CANWrite(BFPCTRL, B00001111); // setting interrupts 
  
  attachInterrupt(INT_PIN, ISR_can, FALLING);
  attachInterrupt(RBUTTON_INT, ISR_debounce, FALLING);
  
strip.begin();
strip.show();

display.begin(SSD1306_SWITCHCAPVCC, 0x3D);
display.clearDisplay();
display.drawBitmap(0,0, miatalogo_bmp, 128, 64, 1);
display.display();
delay(1000);
display.clearDisplay();
}

void loop() {

//  pull_data();
  delay(1);
  R_index=myEnc.read()/4;
  lc1_transmit();
  delay(1);
  /*
  if (! value_oob() ) {
    switch (B_index) {
      case 0: gauge_vitals();  break;
      case 1: gauge_single(); break;
      case 2: gauge_histogram();  break;
      case 3: gauge_debug(); break;  
      case 4: gauge_danger(); break;
      case 5: gauge_menu(); break;
      //default: write_gauge_3(); break;
    }
    write_neopixel();

  } else {
    gauge_warning();
    strip.show();
  } */ 
  display.display();
}


void ISR_debounce () {
if((long)(millis() - last_millis) >= (debouncing_time * 10)) {  
  display.clearDisplay();
    if (S_index != 0) {
      S_index=0; // deselect brightness
      display.clearDisplay();
      return;
    }
  if (B_index < 5) {
    B_index++;
    M_index=0;
    R_index=0;
    myEnc.write(0);
    }
  if (B_index == 5) { 
    //menu settings
    B_index=5; 
    if (R_index >= 3) {
        //save selected - return to main menu
        M_index=0;
        B_index=0;
        R_index=0;
        myEnc.write(0);
        S_index=0;
      }
    if (R_index == 1) {
      S_index=1; // select brightness
    }
    if (R_index == 2) {
      S_index=2; // select text size, though not implemented
    }
  } // end B_index5
} else {return; }//end button
  last_millis = millis();
}//end debounce

void gauge_histogram() {
  byte val;
    
val = AFR - 100; // temporary  
  
if (millis() > (validity_window + 80)) { // 10hz update time
  display.clearDisplay();
  
  if (R_index > 2 || R_index < 0) { R_index=0; myEnc.write(0); }
  switch (R_index) {
    // 0-50 value normalization
    case 0: 
      val = (AFR - 100) / 2; // real rough estimation here here of afr on a 0-50 scale
      if (val > 50) { val=50; }
      break;
    case 1:
      val = ((MAP/10) - 30) / 4;
      if (val > 50) { val = 50; }
      break;
    case 2:
      val = (MAT/10) / 4;
      if (val > 50) { val = 50; }
      break;
  }
  
  histogram_index++;
  if (histogram_index >=64) {
    histogram_index=0;
  }
  histogram[histogram_index]=val;
  
  for (byte i = 0; i < 64; i++) {
    int x = histogram_index - i;
    if ( x < 0) {
      x = 64 + histogram_index - i;
    }
    display.drawFastVLine((128 - (i * 2)), (64 - histogram[x]), 64, WHITE);
    display.drawFastVLine((127 - (i * 2)), (64 - histogram[x]), 64, WHITE);       
  }
  
  display.setCursor(8,0);
  display.setTextSize(2);
  display.setTextColor(WHITE);
  
  switch (R_index) {
    case 0:
      display.print("AFR ");
      divby10(AFR);
      display.print(tempchars);
      display.drawFastHLine(0, 40, 128, WHITE); // stoich 14.7 line
      for (byte x=1; x < 128; x = x + 2) { display.drawPixel(x, 40, BLACK); }
      break;
   case 1:
     display.print("MAP ");
     display.print(MAP/10);
     display.drawFastHLine(0, 47, 128, WHITE); // Baro line.. roughly 98kpa
     for (byte x=1; x < 128; x = x + 2) { display.drawPixel(x, 47, BLACK); }
     break;
   case 2:
     display.print("MAT ");
     display.print(MAT / 10);
     break;
  }

/*  refresh rate debug  
  display.setCursor(50, 0);
  display.setTextSize(1);
  display.setTextColor(WHITE);
  display.print(" t");
  display.print((millis() - validity_window));
  display.print(" v");
  display.print(val);
  */
  validity_window=millis();
//  display.display(); 
}//end millis
  
}

boolean value_oob() {
  if (RPM > 100) {
    if ((CLT/10) > 260) return 1;
//    if (OILP < 7 ) return 1;
//    if (RPM > 7600 ) return 1;
//    if (EGT > 1550 ) return 1;
    //if (indicator[4] != 0) return 1;
  } else {
    return 0;
  }
  if (RPM > 6800 && TPS > 900) return 1;
}

void gauge_warning() {
byte dlength, llength;
int midpos;

display.clearDisplay();

if (RPM > 6800 && TPS > 900) {
  dlength=4;
  llength=3;
  midpos=(63 - ((dlength * 23) / 2));
  display.setTextColor(WHITE);
  display.setCursor(midpos,0);
  display.setTextSize(4);
  display.print(RPM);
 
  display.setTextSize(2);
  display.setCursor(8, (63 - 15));
  display.print("RPM");
  
  for (byte i = 0; i < 16; i++) {
    strip.setPixelColor(i, 0, 0, 0);
  } // zero out
  
  byte i = ((RPM - 6800) / 50);

  for (byte p=0; p < i; p++) {
    if (i <= 2) {
      strip.setPixelColor(p + 14, ((255 * neo_brightness) / 16), 0, 0);
    } else {
      strip.setPixelColor(14, ((255 * neo_brightness) / 16), 0, 0);
      strip.setPixelColor(15, ((255 * neo_brightness) / 16), 0, 0);
      strip.setPixelColor(p-2, ((255 * neo_brightness) / 16), 0, 0);
    }
  }

  
}

if ((CLT/10) > 260) {
  dlength=3;
  llength=3;
  midpos=(63 - ((dlength * 23) / 2));
  display.setTextColor(WHITE);
  display.setCursor(midpos,0);
  display.setTextSize(4);
  display.print(CLT/10);
 
  display.setTextSize(2);
  display.setCursor(8, (63 - 15));
  display.print("CLT");  
  for (byte i=0; i < 16; i++) {
    neogauge(999, i, 0);  
  }
}

if (bitRead(indicator[4], 0)) {
  display.setTextColor(WHITE);
  dlength=3;
  midpos=(63 - ((dlength * 23) / 2));
  display.setCursor(29, 0);
  display.setTextSize(4);
  display.print("MAP");
  display.setTextSize(2);
  display.setCursor(8, 48);
  display.print("Error");
  for (byte i=0; i < 16; i++) {
    neogauge(999, i, 0);  
  }  
}

if (bitRead(indicator[4], 1)) {
  display.setTextColor(WHITE);
  dlength=3;
  midpos=(63 - ((dlength * 23) / 2));
  display.setCursor(29, 0);
  display.setTextSize(4);
  display.print("MAT");
  display.setTextSize(2);
  display.setCursor(8, 48);
  display.print("Error");
  for (byte i=0; i < 16; i++) {
    neogauge(999, i, 0);  
  }

}

if (bitRead(indicator[4], 2)) {
  display.setTextColor(WHITE);
  dlength=3;
  midpos=(63 - ((dlength * 23) / 2));
  display.setCursor(29, 0);
  display.setTextSize(4);
  display.print("CLT");
  display.setTextSize(2);
  display.setCursor(8, 48);
  display.print("Error");
  for (byte i=0; i < 16; i++) {
    neogauge(999, i, 0);  
  }
}

if (bitRead(indicator[4], 3)) {
  display.setTextColor(WHITE);
  dlength=3;
  midpos=(63 - ((dlength * 23) / 2));
  display.setCursor(29, 0);
  display.setTextSize(4);
  display.print("TPS");
  display.setTextSize(2);
  display.setCursor(8, 48);
  display.print("Error");
  for (byte i=0; i < 16; i++) {
    neogauge(999, i, 0);  
  }

}

if (bitRead(indicator[4], 4)) {
  display.setTextColor(WHITE);
  dlength=3;
  midpos=(63 - ((dlength * 23) / 2));
  display.setCursor(29, 0);
  display.setTextSize(4);
  display.print("BATT");
  display.setTextSize(2);
  display.setCursor(8, 48);
  display.print("Error");
  for (byte i=0; i < 16; i++) {
    neogauge(999, i, 0);  
  }  
}

if (bitRead(indicator[4], 5)) {
  display.setTextColor(WHITE);
  dlength=3;
  midpos=(63 - ((dlength * 23) / 2));
  display.setCursor(29, 0);
  display.setTextSize(4);
  display.print("AFR");
  display.setTextSize(2);
  display.setCursor(8, 48);
  display.print("Error");
  for (byte i=0; i < 16; i++) {
    neogauge(999, i, 0);  
  }  
}

if (bitRead(indicator[4], 6)) {
  display.setTextColor(WHITE);
  dlength=3;
  midpos=(63 - ((dlength * 23) / 2));
  display.setCursor(29, 0);
  display.setTextSize(4);
  display.print("Sync");
  display.setTextSize(2);
  display.setCursor(8, 48);
  display.print("Error");
  for (byte i=0; i < 16; i++) {
    neogauge(999, i, 0);  
  }  
}

if (bitRead(indicator[4], 7)) {
  display.setTextColor(WHITE);
  dlength=3;
  midpos=(63 - ((dlength * 23) / 2));
  display.setCursor(29, 0);
  display.setTextSize(4);
  display.print("EGT");
  display.setTextSize(2);
  display.setCursor(8, 48);
  display.print("Error");
  for (byte i=0; i < 16; i++) {
    neogauge(999, i, 0);  
  }  
}
 
}


void gauge_debug() {
  display.setCursor(32,0);
  display.setTextSize(1);
  display.setTextColor(WHITE);
  display.print("m");
  display.print(M_index); 
  display.print("r"); 
  display.print(R_index);
  display.print("s"); 
  display.print(S_index);
  display.print("b");
  display.println(B_index);
  display.setTextSize(2);
}

void divby10(int val) {
byte length;

  itoa(val, tempchars, 10);
  length=strlen(tempchars);

  tempchars[length + 1]=tempchars[length]; // null shift right
  tempchars[length]=tempchars[length - 1]; //  
  tempchars[length - 1]='.';
}

void gauge_vitals() {
  //hard coded for style
  // fonts are 5x7 * textsize 
  // size 1 .. 5 x 7
  // size 2 .. 10 x 14
  //Vitals - AFR, RPM, MAP, 
  display.clearDisplay();
  
//  display.drawLine(63, 0, 63, 55, WHITE); //vert centerline
//  display.drawLine(0, 31, 127, 31, WHITE); //horiz centerline
  
  display.setTextSize(2);
  display.setTextColor(WHITE);
  display.setCursor(0,0);
  
  display.setCursor(41, 0); // 4 char normally - 4 * 10 = 40, - 128 = 88, /2 = 44 
  display.println(RPM);
  display.setTextSize(1);
  display.setCursor(21, 7); 
  display.print("RPM");
  
  //line2
  display.setCursor(2, 26);
  display.setTextSize(1);
  display.print("AFR");
  display.setCursor(20, 19);
  display.setTextSize(2);
  divby10(AFR);
  display.print(tempchars);

  display.setCursor(69,19);
  display.setTextSize(1);
  display.print("AFR");
  display.drawTriangle(72, 32, 77, 27, 82, 32, WHITE); 
  divby10(AFR - AFRtgt);
  display.setTextSize(1);
  display.setCursor(88,26);
  display.print(tempchars);
  display.setCursor(88,18);
  divby10(AFRtgt);
  display.print(tempchars);
  
  //line3
  display.setCursor(0, 40);
  display.setTextSize(1);
  display.print("MAP");
  display.setCursor(20, 40);
  display.setTextSize(2);
//  divby10(MAP); doesn't need single point resolution
  display.print(MAP/10);
  
  if ( bitRead(indicator[2],7) == 1) { // contextual gauge - if idle on, show IAC%
    display.setCursor(72, 47);
    display.setTextSize(1);
    display.print("IAC");
    display.setCursor(92, 40);
    display.setTextSize(2);
    display.print(IAC);
  } else if (MAP > Baro) {
    int psi;
    display.setCursor(72, 38);
    display.setTextSize(1);
    display.print("PSI");
    display.setCursor(92, 38);
    display.setTextSize(1);
    // 6.895kpa = 1psi
    psi = MAP - Baro;
    psi=(psi * 200) / 1379;
    divby10(psi);
    display.print(tempchars);
  
    display.setCursor(72, 47);
    display.setTextSize(1);
    display.print("MAT");
    display.setCursor(92, 47);
    display.print(MAT/10);
    
  }  else {
    display.setCursor(72, 47);
    display.setTextSize(1);
    display.print("MAT");
    display.setCursor(92,40);
    display.setTextSize(2);
//    divby10(MAT);
    display.print(MAT/10);
  }
  
  gauge_bottom();
//  display.display();  
} // end gauge_vitals

void gauge_bottom() {

display.setTextSize(1);
display.drawFastHLine(1, (63 - 7), 126, WHITE);
display.setCursor(0, 57);
display.setTextColor(BLACK, WHITE);
//display.print("CELIDLFANKNKBSTAFR");
display.setTextColor(BLACK, WHITE);

//CEL
if ( indicator[4] != 0 ) {
  display.setTextColor(BLACK, WHITE);
  display.drawFastVLine(2, 57, 8, WHITE);
} else {
  display.setTextColor(WHITE);
}
display.setCursor(3, 57);
display.print("CEL");
display.drawFastVLine(1, 57, 8, WHITE);

//FAN
if ( bitRead(indicator[6],6) == 1) {
  display.setTextColor(BLACK, WHITE);
  display.drawFastVLine(23, 57, 8, WHITE);
  display.drawFastVLine(22, 57, 8, WHITE);
  display.drawFastVLine(42, 57, 8, WHITE);
} else {
  display.setTextColor(WHITE);}
display.setCursor(24, 57);
display.print("FAN");
display.drawFastVLine(21, 57, 8, WHITE);

//Idle
if ( bitRead(indicator[2],7) == 1) {
  display.setTextColor(BLACK, WHITE);
  display.drawFastVLine(44, 57, 8, WHITE);
} else {
  display.setTextColor(WHITE);}
display.setCursor(45, 57);
display.print("Idl");
display.drawFastVLine(43, 57, 8, WHITE);

//Knock
if ( bitRead(indicator[7],4) == 1) {
  display.setTextColor(BLACK, WHITE);
  display.drawFastVLine(65, 57, 8, WHITE);
  display.drawFastVLine(64, 57, 8, WHITE);
  display.drawFastVLine(84, 57, 8, WHITE);
} else {
  display.setTextColor(WHITE);}
display.setCursor(66, 57);
display.print("KnK");
display.drawFastVLine(63, 57, 8, WHITE);

//Overboost
if ( bitRead(indicator[2],6) == 1) {
  display.setTextColor(BLACK, WHITE);
  display.drawFastVLine(87, 57, 8, WHITE);
  display.drawFastVLine(86, 57, 8, WHITE);
} else {
  display.setTextColor(WHITE);}
display.setCursor(88, 57);
display.print("Bst");
display.drawFastVLine(85, 57, 8, WHITE);

//WUE
if ( bitRead(indicator[0],3) == 1) {
  display.setTextColor(BLACK, WHITE);
  display.drawFastVLine(107, 57, 8, WHITE);
} else {
  display.setTextColor(WHITE);}
display.setCursor(108, 57);
display.print("WUE");
display.drawFastVLine(106, 57, 8, WHITE);
display.drawFastVLine(126, 57, 8, WHITE);


//FAN, WUE, ASE, CEL, Idl, Knk, over boost
//CEL - Idl - FAN - KnK - BST - AFR
}

void gauge_single() {
  byte mult_test;
  char data[10];
  String label;
  byte temp_index;
  display.clearDisplay();
//  unsigned int RPM, CLT, MAP, MAT, SPKADV, BATTV, TPS, Knock, Baro, EGOc, IAC, dwell, bstduty, idle_tar;
//  int AFR, AFRtgt;
  if (R_index < 0) {
    myEnc.write(0);
    R_index=0;
  }
  
  if (R_index <= 15) {
  switch (R_index) {
    case 0: label="RPM"; itoa(RPM, data, 10); break;
    case 1: label="AFR"; divby10(AFR); strcpy(data, tempchars); break;
    case 2: label="Coolant"; divby10(CLT); strcpy(data, tempchars); break;
    case 3: label="MAP"; divby10(MAP); strcpy(data, tempchars); break;
    case 4: label="MAT"; divby10(MAT); strcpy(data, tempchars); break;
    case 5: label="Timing"; divby10(SPKADV); strcpy(data, tempchars); break;
    case 6: label="Voltage"; divby10(BATTV); strcpy(data, tempchars); break;
    case 7: label="TPS"; divby10(TPS); strcpy(data, tempchars); break;
    case 8: label="Knock"; divby10(Knock); strcpy(data, tempchars); break;
    case 9: label="Barometer"; divby10(Baro); strcpy(data, tempchars); break;
   case 10: label="EGO Corr"; divby10(EGOc); strcpy(data, tempchars); break;
   case 11: label="IAC"; itoa(IAC, data, 10); break;
   case 12: label="Spark Dwell"; divby10(dwell); strcpy(data, tempchars); break;
   case 13: label="Boost Duty"; itoa(bstduty, data, 10); break;
   case 14: label="Idle Target"; itoa(idle_tar, data, 10); break;
   case 15: label="AFR Target"; divby10(AFRtgt); strcpy(data, tempchars); break;
   } 
  } else {
    temp_index = R_index - 15;
    char temporary[15];
    byte sbyte, bitp, dbit;
    strcpy_P(temporary, MSDataBin[temp_index].name);
    label=temporary;
    
    sbyte=pgm_read_byte(&MSDataBin[temp_index].sbyte);
    bitp=pgm_read_byte(&MSDataBin[temp_index].bitp);
    dbit=bitRead(indicator[sbyte], bitp); 
    if ( dbit == 1 ) {
      data[0]='O';
      data[1]='n';
      data[2]='\0';
    } else {
      data[0]='O';
      data[1]='f';
      data[2]='f';
      data[3]='\0';
    }
    
  }
  
 byte dlength=strlen(data);
 byte llength=label.length();
 int midpos;
 
 //dlength * (width of font) / 2 -1
//size 2 = 11
//size 3 = 17
//size 4 = 23
 
midpos = (63 - ((dlength * 23)/ 2));

 display.setTextColor(WHITE);
 display.setCursor(midpos,0);
 display.setTextSize(4);
 display.print(data);
 
display.setTextSize(2);
display.setCursor(8, (63 - 15));
display.print(label);

//unsigned int MAP_HI, Knock_HI, RPM_HI, CLT_HI, MAT_HI;
//int AFR_HI, AFR_LO;

//Additional Hi-Lo's for niftiness
if (R_index == 0) {
  if (millis() > (validity_window + 30000)) {
    //after 30 seconds from latest high, set new high
    RPM_HI = RPM;
    validity_window=millis();
  }
  if (RPM > RPM_HI) {
    RPM_HI = RPM;
    validity_window=millis();
  }
  display.setTextSize(2);
  display.setCursor((127 - 48), 31);
  display.print(RPM_HI);
}

if (R_index == 1) {
  if (millis() > (validity_window + 30000)) {
    //after 30 seconds from latest high, set new high
    AFR_HI = AFR;
    validity_window=millis();
  }
  if (millis() > (validity_window2 + 30000)) {
    //after 30 seconds from latest high, set new high
    AFR_LO = AFR;
    validity_window2=millis();
  }  
  if (AFR > AFR_HI) {
    AFR_HI = AFR;
    validity_window=millis();
  }
  if (AFR < AFR_LO) {
    AFR_LO = AFR;
    validity_window2=millis();
  }
  display.setTextSize(2);
  display.setCursor(0, 31);
  divby10(AFR_LO);
  display.print(tempchars);
  display.setCursor((127 - 48), 31);
  divby10(AFR_HI);
  display.print(tempchars);
}

if (R_index == 2) {
  if (millis() > (validity_window + 30000)) {
    //after 30 seconds from latest high, set new high
    CLT_HI = CLT;
    validity_window=millis();
  }
  if (CLT > CLT_HI) {
    CLT_HI = CLT;
    validity_window=millis();
  }
  display.setTextSize(2);
  display.setCursor((127 - 60), 31);
  divby10(CLT_HI);
  display.print(tempchars);
}

if (R_index == 3) {
  if (millis() > (validity_window + 30000)) {
    //after 30 seconds from latest high, set new high
    MAP_HI = MAP;
    validity_window=millis();
  }
  if (MAP > MAP_HI) {
    MAP_HI = MAP;
    validity_window=millis();
  }
  display.setTextSize(2);
  display.setCursor((127 - 48), 31);
  divby10(MAP_HI);
  display.print(tempchars);
}

if (R_index == 4) {
  if (millis() > (validity_window + 30000)) {
    //after 30 seconds from latest high, set new high
    MAT_HI = MAT;
    validity_window=millis();
  }
  if (MAT > MAT_HI) {
    MAT_HI = MAT;
    validity_window=millis();
  }
  display.setTextSize(2);
  display.setCursor((127 - 48), 31);
  divby10(MAT_HI);
  display.print(tempchars);
}

if (R_index == 8) {
  if (millis() > (validity_window + 30000)) {
    //after 30 seconds from latest high, set new high
    Knock_HI = Knock;
    validity_window=millis();
  }
  if (Knock > Knock_HI) {
    Knock_HI = Knock;
    validity_window=millis();
  }
  display.setTextSize(2);
  display.setCursor((127 - 48), 31);
  divby10(Knock_HI);
  display.print(tempchars);
  } 
// display.display();  
}//end gauge_single

void gauge_menu() {
//display.setTextSize(1);display.setTextColor(WHITE);display.print("m");display.print(M_index); display.print("r"); display.print(R_index);display.print("s"); display.print(S_index);display.print("b");display.println(B_index);display.setTextSize(2);

if (R_index < 0) { R_index = 0;}
display.setTextColor(WHITE);
display.clearDisplay();
display.setCursor(0,0);
display.setTextSize(2);

if (S_index == 0) {
  switch (R_index) {

    case 0: 
    //line1
      display.setTextColor(BLACK, WHITE);
      display.println("_Menu");
    //line2
      display.setTextColor(WHITE);
      display.print("Lum: ");
      display.println(neo_brightness);
    //line3
      display.print("Text: ");
      display.println(g_textsize);
    //line4
      display.print("Save");
      display.display();
    break;

    case 1: //brightness selected
    //line1
      display.setTextColor(WHITE);
      display.println("_Menu");
    //line2
      display.setTextColor(BLACK, WHITE);
      display.print("Lum: ");
      display.println(neo_brightness);
    //line3
      display.setTextColor(WHITE);
      display.print("Text: ");
      display.println(g_textsize);
    //line4
      display.print("Save");
      display.display();    
    break;

    case 2: //text size selected
    //line1
      display.setTextColor(WHITE);
      display.println("_Menu");
    //line2
      display.print("Lum: ");
      display.println(neo_brightness);
    //line3
      display.setTextColor(BLACK, WHITE);
      display.print("Text: ");
      display.println(g_textsize);
    //line4
      display.setTextColor(WHITE);
      display.print("Save");
      display.display();
    break;

    case 3: //save selected
    //line1
      display.setTextColor(WHITE);
      display.println("_Menu");
    //line2
      display.print("Lum: ");
      display.println(neo_brightness);
    //line3
      display.setTextColor(WHITE);
      display.print("Text: ");
      display.println(g_textsize);
    //line4
      display.setTextColor(BLACK, WHITE);
      display.print("Save");
      display.display();
    break;
  } //end switch
} // end S_index 0

  if (S_index == 1) {
  neo_brightness=R_index;
  display.clearDisplay();
  display.setCursor(0,0);
  if (R_index > 8) {
    R_index = 8;
    myEnc.write(8*4);
    neo_brightness = 8;
    }
  if (R_index < 1) {
    R_index = 1; 
    myEnc.write(1);
    neo_brightness=1; 
    }
  //line1
    display.setTextColor(WHITE);
    display.println("_Menu");
  //line2
    display.setTextColor(BLACK, WHITE);
    display.print("Lum: ");
    display.println(neo_brightness);
  //line3
    display.setTextColor(WHITE);
    display.print("Text: ");
    display.println(g_textsize);
  //line4
    display.print("Save");
    display.display();
  }// brightness selection, end S_index 1
  
if (S_index == 2) {
//  temp=M_index;
  g_textsize=R_index;
/*  if (R_index > 4) {
    R_index = 4;
    myEnc.write(16);
    g_textsize = 4;
    }*/
  if (R_index < 1) {
    R_index = 1;
    myEnc.write(4); 
    g_textsize=1; 
    }
  //line1
    display.setTextColor(WHITE);
    display.println("_Menu");
  //line2
    display.print("Lum: ");
    display.println(neo_brightness);
  //line3
    display.setTextColor(BLACK, WHITE);
    display.print("Text: ");
    display.println(g_textsize);
  //line4
    display.setTextColor(WHITE);
    display.print("Save");
    display.display();
  }// text size selection S_index 2
} // end gauge_menu

void gauge_danger() {
display.setTextSize(2);
display.setTextColor(WHITE);
display.clearDisplay();
display.setCursor(0,0);

display.setCursor(4,0);
display.setTextSize(2);
display.print("Warning");
display.print("!");
display.print("!");
display.print("!");

display.setCursor(10,28);
display.print("Danger to"); 
display.setCursor(12,45);
display.println("Manifold");
//display.display();
}

void pull_data() {
/* 
for some reason, this doesn't work well within a for loop. I guess
it has to do with the nature of interrupts, but I'm not sure.
*/
  byte x;  
  x=0;
  MSrequest(MSData[x].block, MSData[x].offset, MSData[x].reqbytes);
  delay(1);
  x=1;
  MSrequest(MSData[x].block, MSData[x].offset, MSData[x].reqbytes);
  delay(1);
  x=2;
  MSrequest(MSData[x].block, MSData[x].offset, MSData[x].reqbytes);
  delay(1);
  x=3;
  MSrequest(MSData[x].block, MSData[x].offset, MSData[x].reqbytes);
  delay(1);
  x=4;
  MSrequest(MSData[x].block, MSData[x].offset, MSData[x].reqbytes);
  delay(1);
  x=5;
  MSrequest(MSData[x].block, MSData[x].offset, MSData[x].reqbytes);
  delay(1);
  x=6;
  MSrequest(MSData[x].block, MSData[x].offset, MSData[x].reqbytes);
  delay(1);
  x=7;
  MSrequest(MSData[x].block, MSData[x].offset, MSData[x].reqbytes);
  delay(1);
  x=8;
  MSrequest(MSData[x].block, MSData[x].offset, MSData[x].reqbytes);
  delay(1);
  x=9;
  MSrequest(MSData[x].block, MSData[x].offset, MSData[x].reqbytes);
  delay(1);
  x=10;
  MSrequest(MSData[x].block, MSData[x].offset, MSData[x].reqbytes);
  delay(1);
  x=11;
  MSrequest(MSData[x].block, MSData[x].offset, MSData[x].reqbytes);
  delay(1);
  x=12;
  MSrequest(MSData[x].block, MSData[x].offset, MSData[x].reqbytes);
  delay(1);
  x=13;
  MSrequest(MSData[x].block, MSData[x].offset, MSData[x].reqbytes);
  delay(1);
  x=14;
  MSrequest(MSData[x].block, MSData[x].offset, MSData[x].reqbytes);
  delay(1);
  x=15;
  MSrequest(MSData[x].block, MSData[x].offset, MSData[x].reqbytes);
  delay(1);
  MSrequest(7, 11, 1); //indicator0
  delay(1);
  MSrequest(7, 78, 1); //indicator1
  delay(1);
  MSrequest(7, 79, 1); //indicator2
  delay(1);
  MSrequest(7, 80, 1); //indicator3
  delay(1);
  MSrequest(7, 325, 1); //indicator4
  delay(1);
  MSrequest(7, 70, 1); //indicator5
  delay(1);
  MSrequest(7, 233, 1); //indicator6
  delay(1);
  MSrequest(7, 351, 1); //indicator7
}

void ISR_can() {
  byte SIDH, SIDL, EID8, EID0, DLC;
  byte databuffer[7];
  unsigned int data; 
  byte block, canintf, temp;
  unsigned int offset;

  canintf=CANRead(CANINTF); // which buffer?
  if (canintf & B00000001) {
    SIDH=CANRead(RXB0SIDH);
    SIDL=CANRead(RXB0SIDL);
    EID8=CANRead(RXB0EID8);
    EID0=CANRead(RXB0EID0);
    DLC=CANRead(RXB0DLC);
    databuffer[0]=CANRead(RXB0D0);
    databuffer[1]=CANRead(RXB0D1);
    databuffer[2]=CANRead(RXB0D2);
    databuffer[3]=CANRead(RXB0D3);
    databuffer[4]=CANRead(RXB0D4);
    databuffer[5]=CANRead(RXB0D5);
    databuffer[6]=CANRead(RXB0D6);
    databuffer[7]=CANRead(RXB0D7);
  } 
  else if (canintf & B00000010) {
    SIDH=CANRead(RXB1SIDH);
    SIDL=CANRead(RXB1SIDL);
    EID8=CANRead(RXB1EID8);
    EID0=CANRead(RXB1EID0);
    DLC=CANRead(RXB0DLC);
    databuffer[0]=CANRead(RXB1D0);
    databuffer[1]=CANRead(RXB1D1);
    databuffer[2]=CANRead(RXB1D2);
    databuffer[3]=CANRead(RXB1D3);
    databuffer[4]=CANRead(RXB1D4);
    databuffer[5]=CANRead(RXB1D5);
    databuffer[6]=CANRead(RXB1D6);
    databuffer[7]=CANRead(RXB1D7);
  }

block=((B01111000 & EID0) >> 3);
temp=0x00;
temp=((B00000100 & EID0) << 3);
block=block | temp;

offset=SIDH;
temp=((SIDL & B11100000) >> 5);
offset=((offset << 3) | temp);

switch (block) {
  case 7:
   switch (offset) {
    case 6: RPM=(int)(word(databuffer[0], databuffer[1])); break;
    case 8: SPKADV=(int)(word(databuffer[0], databuffer[1])); break;
    case 11: indicator[0]=databuffer[0]; break;
    case 12: AFRtgt=(int)(word(0x00, databuffer[0])); break;
    case 16: Baro=(int)(word(databuffer[0], databuffer[1])); break;
    case 18: MAP=(int)(word(databuffer[0], databuffer[1])); break;
    case 20: MAT=(int)(word(databuffer[0], databuffer[1])); break;
    case 22: CLT=(int)(word(databuffer[0], databuffer[1])); break;
    case 24: TPS=(int)(word(databuffer[0], databuffer[1])); break;
    case 26: BATTV=(int)(word(databuffer[0], databuffer[1])); break;
    case 32: Knock=(int)(word(databuffer[0], databuffer[1])); break;
    case 34: EGOc=(int)(word(databuffer[0], databuffer[1])); break;
    case 39: bstduty=(int)(word(databuffer[0], databuffer[1])); break;
    case 54: IAC=(int)(word(databuffer[0], databuffer[1])); IAC = (IAC * 49) / 125; break;
    case 62: dwell=(int)(word(databuffer[0], databuffer[1])); break;
    case 70: indicator[5]=databuffer[0]; break;
    case 78: indicator[1]=databuffer[0]; break;   
    case 79: indicator[2]=databuffer[0]; break;
    case 80: indicator[3]=databuffer[0]; break;
    case 233: indicator[6]=databuffer[0]; break; 
    case 252: AFR=(int)(word(0x00, databuffer[0]));  break;
    case 351: indicator[7]=databuffer[0]; break; 
    case 425: indicator[4]=databuffer[0]; break; 
    case 380: idle_tar=(int)(word(databuffer[0], databuffer[1])); break;
    }// end block 7
  break;
}// end case statement
  CANWrite(CANINTF, 0x00); // clear interrupt
}




int freeRam () {
  extern int __heap_start, *__brkval; 
  int v; 
  return (int) &v - (__brkval == 0 ? (int) &__heap_start : (int) __brkval); 
}


void CANWrite(byte addr, byte data) {
  digitalWrite(CS_PIN,LOW);
  SPI.transfer(CAN_WRITE);
  SPI.transfer(addr);
  SPI.transfer(data);
  digitalWrite(CS_PIN,HIGH);
}

byte CANRead(byte addr) {
  byte data;
  digitalWrite(CS_PIN,LOW);
  SPI.transfer(CAN_READ);
  SPI.transfer(addr);
  data=SPI.transfer(0x00);
  digitalWrite(CS_PIN,HIGH);
  return data;
}


void MSrequest(byte block, unsigned int offset, byte req_bytes) {
  byte SIDH, SIDL, EID8, EID0, DLC, D0, D1, D2;
  
SIDH = lowByte(offset  >> 3);

// var_offset<2:0> SRR IDE msg_type <3:0>
SIDL = (lowByte((offset << 5)) | B0001000); //set IDE bit
//      MFFFFTTT msg_type, From, To
EID8 = B10011000; //:7 msg_req, from id 3 (4:3)

//      TBBBBBSS To, Block, Spare
EID0 = ( ( block & B00001111) << 3); // last 4 bits, move them to 6:3
EID0 = ((( block & B00010000) >> 2) | EID0); // bit 5 goes to :2

DLC = B00000011;
D0=(block);
D1=(offset >> 3);
D2=(((offset & B00000111) << 5) | req_bytes); // shift offset
  
  
digitalWrite(CS_PIN,LOW);
  SPI.transfer(0x40); // Push bits starting at 0x31 (RXB0SIDH)
  SPI.transfer(SIDH); //0x31
  SPI.transfer(SIDL); //0x32
  SPI.transfer(EID8); //0x33
  SPI.transfer(EID0); //0x34
  SPI.transfer(DLC);  //0x35
  SPI.transfer(D0); // 0x36 TXB0D0 my_varblk
  SPI.transfer(D1); // 0x37 TXB0D1 my_offset
  SPI.transfer(D2); // 0x38 TXB0D2 - request 8 bytes(?) from MS3
digitalWrite(CS_PIN,HIGH); // end write

// RTS - Send this buffer down the wire
digitalWrite(CS_PIN,LOW);
  SPI.transfer(B10000001);
digitalWrite(CS_PIN,HIGH);

CANWrite(CANINTF,0x00);

}

unsigned int MSrx_int() {
 unsigned int data;

data=( CANRead(RXB0D0) << 8);
data=( data | (CANRead(RXB0D0)));

CANWrite(CANINTF, 0x00); // clear int
return data;
}

void MSrx() {
byte SIDH, SIDL, EID8, EID0, DLC;
 byte databuffer[7];
 unsigned int data; 
 SIDH=CANRead(RXB0SIDH);
 SIDL=CANRead(RXB0SIDL);
 EID8=CANRead(RXB0EID8);
 EID0=CANRead(RXB0EID0);
 DLC=CANRead(RXB0DLC);
 
 databuffer[0]=CANRead(RXB0D0);
 databuffer[1]=CANRead(RXB0D1);
 databuffer[2]=CANRead(RXB0D2);
 databuffer[3]=CANRead(RXB0D3);
 databuffer[4]=CANRead(RXB0D4);
 databuffer[5]=CANRead(RXB0D5);
 databuffer[6]=CANRead(RXB0D6);
 databuffer[7]=CANRead(RXB0D7);

Serial.print("SIDH: ");
bytePrint(SIDH);
Serial.println("");
Serial.print("SIDL: ");
bytePrint(SIDL);
Serial.println("");
Serial.print("EID8: ");
bytePrint(EID8);
Serial.println("");
Serial.print("EID0: ");
bytePrint(EID0);
Serial.println("");
Serial.print("DLC: ");
bytePrint(DLC);
Serial.println("");
Serial.print("Data: ");
data=databuffer[0];
data=((data << 8) | databuffer[1]);
//Serial.println(data);
byte datalength=(DLC & 0x0F);

for (byte x=0 ; x < datalength ; x++) {
  bytePrint(databuffer[x]);
 }
}

void bytePrint(byte victim) {
  boolean temp;
  Serial.print("b");
  for (int x = 7; x >=0; x--) {
    temp=bitRead(victim,x);
    Serial.print(temp,BIN);
  }
}


void neogauge(int val, byte led, byte enable_warning) {
  unsigned int red, green, blue;
  val = val/2;
  
  if ( val > 500 ) {
    if (enable_warning > 0) {
    strip.setPixelColor(led, 0, 0, 0);
    strip.show();
    delay(50);
    red = (255 * neo_brightness) / 16;
    strip.setPixelColor(led, red, 0, 0);
    strip.show();
    } else {
      red = (255 * neo_brightness) / 16;
      strip.setPixelColor(led, red, 0, 0);
      strip.show();
    }
  } else if ( val < 0 ) {
    if (enable_warning > 0) {
    strip.setPixelColor(led, 0, 0, 0);
    strip.show();
    delay(50);
    blue = (255 * neo_brightness) / 16;
    strip.setPixelColor(led, 0, 0, blue);
    strip.show();    
    } else {
    blue = (255 * neo_brightness) / 16;
    strip.setPixelColor(led, 0, 0, blue);
    strip.show();    
    }
  } else if ((val >= 0) && (val <= 500)) {
    red =   pgm_read_byte (&ledarray[val].r0);
    green = pgm_read_byte (&ledarray[val].g0);
    blue =  pgm_read_byte (&ledarray[val].b0);
    red = (red * neo_brightness) / 16;
    green = (green * neo_brightness) / 16;
    blue = (blue * neo_brightness) / 16;
    strip.setPixelColor(led, red, green, blue);
//    strip.show();
  }
}

void neogauge4led(int val, byte led0, byte led1, byte led2, byte led3, byte enable_warning) {
  unsigned int red, green, blue;
  val = val/2;
  
  if ( val > 500 ) {
    if (enable_warning > 0) {
      strip.setPixelColor(led0, 0, 0, 0);
      strip.setPixelColor(led1, 0, 0, 0);
      strip.setPixelColor(led2, 0, 0, 0);
      strip.setPixelColor(led3, 0, 0, 0);
      strip.show();
      delay(50);
      red = (255 * neo_brightness) / 16;
      strip.setPixelColor(led0, red, 0, 0);
      strip.setPixelColor(led1, red, 0, 0);
      strip.setPixelColor(led2, red, 0, 0);
      strip.setPixelColor(led3, red, 0, 0);
      strip.show(); 
    } else {
      red = (255 * neo_brightness) / 16;
      strip.setPixelColor(led0, red, 0, 0);
      strip.setPixelColor(led1, red, 0, 0);
      strip.setPixelColor(led2, red, 0, 0);
      strip.setPixelColor(led3, red, 0, 0);
      strip.show();
    }
    
  } else if ( val < 0 ) {
      if (enable_warning > 0) {
        strip.setPixelColor(led0, 0, 0, 0);
        strip.setPixelColor(led1, 0, 0, 0);
        strip.setPixelColor(led2, 0, 0, 0);
        strip.setPixelColor(led3, 0, 0, 0);
        strip.show();
        delay(50);
        blue = (255 * neo_brightness) / 16;
        strip.setPixelColor(led0, 0, 0, blue);
        strip.setPixelColor(led1, 0, 0, blue);
        strip.setPixelColor(led2, 0, 0, blue);
        strip.setPixelColor(led3, 0, 0, blue);
        strip.show();
      } else {
        blue = (255 * neo_brightness) / 16;
        strip.setPixelColor(led0, 0, 0, blue);
        strip.setPixelColor(led1, 0, 0, blue);
        strip.setPixelColor(led2, 0, 0, blue);
        strip.setPixelColor(led3, 0, 0, blue);
        strip.show();
      }
  } else {
    red   = pgm_read_byte (&ledarray[(val)].r0);
    green = pgm_read_byte (&ledarray[(val)].g0);
    blue  = pgm_read_byte (&ledarray[(val)].b0);
    red = (red * neo_brightness) / 16;
    green = (green * neo_brightness) / 16;
    blue = (blue * neo_brightness) / 16;
    strip.setPixelColor(led0, red, green, blue);

    red   = pgm_read_byte (&ledarray[(val)].r1);
    green = pgm_read_byte (&ledarray[(val)].g1);
    blue  = pgm_read_byte (&ledarray[(val)].b1);
    red = (red * neo_brightness) / 16;
    green = (green * neo_brightness) / 16;
    blue = (blue * neo_brightness) / 16;
    strip.setPixelColor(led1, red, green, blue);

    red   = pgm_read_byte (&ledarray[(val)].r2);
    green = pgm_read_byte (&ledarray[(val)].g2);
    blue  = pgm_read_byte (&ledarray[(val)].b2);
    red = (red * neo_brightness) / 16;
    green = (green * neo_brightness) / 16;
    blue = (blue * neo_brightness) / 16;
    strip.setPixelColor(led2, red, green, blue);

    red   = pgm_read_byte (&ledarray[(val)].r3);
    green = pgm_read_byte (&ledarray[(val)].g3);
    blue  = pgm_read_byte (&ledarray[(val)].b3);
    red = (red * neo_brightness) / 16;
    green = (green * neo_brightness) / 16;
    blue = (blue * neo_brightness) / 16;
    strip.setPixelColor(led3, red, green, blue);

//    strip.show();
  }
}

void write_neopixel() {
long temp;
//  unsigned int RPM, AFR, CLT, MAP, MAT, SPKADV, BATTV, TPS, Knock, Baro, EGOc, IAC, dwell, bstduty, idle_tar, AFRtgt;
//  void neogauge4led(int val, byte led0, byte led1, byte led2, byte led3) 
//  void neogauge(int val, byte led) 

temp = (RPM * 5) / 38;
neogauge4led(temp, 1, 0, 15, 14, 1); // RPM min 0 max 7600

temp = ((AFR * 2) * 100) / 59;
if (AFR <= 147) {
  temp = (pow((AFR - 147),3) / 150) + 500;
} else if (AFR > 147) {
  temp = (pow((AFR - 147),3) / 20) + 500;
}
neogauge4led(temp, 9, 10, 11, 12, 0); // AFR

temp=TPS;
neogauge(temp, 2, 0); //TPS - min 0 max 1000

temp=(CLT * 5) / 12; //CLT - min ? mid 120 max 240
neogauge(temp, 4, 1);


temp=(MAT * 5) / 7; //MAT - min ? mid 70 max 140
neogauge(temp, 6, 0);

temp=MAP/2;
neogauge(temp, 8, 0); //MAP - min impossible mid 100kpa max 200kpa

// will need to play with this some, 50 looks reasonable though
temp=((AFR - AFRtgt) * 50) + 500; 
neogauge(temp, 13, 0);

strip.setPixelColor(3, 0, 0, 0); // unallocated
strip.setPixelColor(5, 0, 0, 0);
strip.setPixelColor(7, 0, 0, 0);

strip.show();

//todo: oil temp, oil pressure, EGT
//todo: rearrange LED's into something nicer
//todo: might be faster to do a final strip.show here instead of inside the neogauge functions
}

void lc1_read() {
 byte incoming_byte;
 byte index;
 byte LC1_status;
 byte LC1_AFR;
 byte LC1_AFRs;
 int LC1_lambda;
 byte packet[7];     
 
 while (Serial2.available() > 0){
    incoming_byte=Serial2.read(); 
    if ( (incoming_byte & 0xA2) == 0xA2 ) { // synchronization byte
      index=0;
      packet[0]=incoming_byte;
    } 
    else if ((index == 0) && ((incoming_byte & 0x80) == 0x80)) { // 2nd syncro byte
      index=1;
      packet[1]=incoming_byte;
    } 
    else {
      index++;
      packet[index]=incoming_byte;
    }
    if (index >= 5 ) {
      LC1_status = (packet[2] & B00011100) >> 2;
      
      LC1_AFRs = (packet[2] & B00000001) << 7;
      LC1_AFRs += packet[3] & B01111111;
      
      LC1_lambda = packet[4] & B00111111;
      LC1_lambda = LC1_lambda << 7;
      LC1_lambda += (packet[5] & B01111111);
            
      switch (LC1_status) {
        case 0: LC1_AFR = LC1_lambda; break; // reporting lambda
        case 1: LC1_AFR = ((LC1_lambda + 500) * LC1_AFRs ) / 1000; break;
        case 2: Serial.println("Free Air Calibration in progress..."); break;
        case 3: Serial.println("Need Calibration"); break;
        case 4: Serial.println("Heater Warming"); break;
        case 5: Serial.println("Heater Calibration"); break;
        case 6: Serial.println("Error Code"); break;
        case 7: Serial.println("Reserved"); break;
      }
      if (LC1_status == 0 ) {
        Serial.print("lambda ");
        Serial.println(LC1_lambda);
        Serial.print("AFR ");
        Serial.println(LC1_AFR);
        index=0;
        for (byte i; i <=6 ; i++) packet[i]=0;
      }
    }// end index_5
 }//end while
}// end lc1_read

void lc1_transmit() {
  byte SIDH, SIDL, EID8, EID0, DLC, D0, D1, D2;
//  byte block, unsigned int offset, byte req_bytes
unsigned int offset = 605;
byte block = 7;
byte req_bytes = 0;
  
  SIDH = lowByte(offset  >> 3);
  // var_offset<2:0> SRR IDE msg_type <3:0>
  SIDL = (lowByte((offset << 5)) | B0001001); //set IDE bit
//        MFFFFTTT msg_type, From, To
  EID8 = B00011000; //:7 msg_req, from id 3 (4:3)
//      TBBBBBSS To, Block, Spare
  EID0 = ( ( block & B00001111) << 3); // last 4 bits, move them to 6:3
  EID0 = ((( block & B00010000) >> 2) | EID0); // bit 5 goes to :2

  DLC = B00001000;
  //D0=(block);
  //D1=(offset >> 3);
  //D2=(((offset & B00000111) << 5) | req_bytes); // shift offset
  
CANWrite(CANINTF,0x00);    
  
digitalWrite(CS_PIN,LOW);
  SPI.transfer(0x40); // Push bits starting at 0x31 (RXB0SIDH)
  SPI.transfer(SIDH); //0x31
  SPI.transfer(SIDL); //0x32
  SPI.transfer(EID8); //0x33
  SPI.transfer(EID0); //0x34
  SPI.transfer(DLC);  //0x35
  SPI.transfer(B00000001); // 0 
  SPI.transfer(B10000000); // 1
  SPI.transfer(0x00); // 2
  SPI.transfer(0x00); // 3
  SPI.transfer(0x00); // 4
  SPI.transfer(0x00); // 5
  SPI.transfer(0x00); // 6
  SPI.transfer(0x00); // 7 
digitalWrite(CS_PIN,HIGH); // end write
/*

1 1111 0100 = 500

Serial.print("txboctrl: ");
Serial.println(CANRead(TXB0CTRL), BIN);
Serial.print("canctrl: ");
Serial.println(CANRead(CANCTRL), BIN);
Serial.print("caninte: ");
Serial.println(CANRead(CANINTE), BIN);
Serial.print("eflg: ");
Serial.println(CANRead(0x2D), BIN);
Serial.print("tec: ");
Serial.println(CANRead(0x1C), BIN);
Serial.print("txtrtsctrl: ");
Serial.println(CANRead(0x0D), BIN);
Serial.println("");
*/


// RTS - Send this buffer down the wire
digitalWrite(CS_PIN,LOW);
  SPI.transfer(B10000001);
digitalWrite(CS_PIN,HIGH);


//CANWrite(TXB0CTRL, B00001011);




//CANWrite(CANINTF,0x00);  
}

